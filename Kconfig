## Kconfig
```kconfig
#
# For a description of the syntax of this configuration file,
# see Documentation/kbuild/kconfig-language.txt.
#
mainmenu "Kbuild hello Configuration"

config SRCARCH
	string
	option env="SRCARCH"

source "common/Kconfig"
source "drivers/Kconfig"
```

## drivers/Kconfig
```kconfig
menu "Device Drivers"

config I2C
	bool "I2C Support"
	default n

if I2C
source drivers/i2c/Kconfig
endif

endmenu
```

## drivers/i2c/Kconfig
```kconfig
menu "I2C Configuration"

config MY_I2C
	bool "MY I2C Support"
	default n

config DW_I2C
	bool "DW I2C Support"
	default n

endmenu
```
